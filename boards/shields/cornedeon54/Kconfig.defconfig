## boards/shields/cornedeon54/Kconfig.defconfig
```kconfig
config ZMK_SPLIT
    default y

if SHIELD_CORNEDEON54_DONGLE || SHIELD_CORNEDEON54_LEFT_CENTRAL

config ZMK_SPLIT_ROLE_CENTRAL
    default y

config BT_MAX_CONN
    default 7

config BT_MAX_PAIRED
    default 7

config ZMK_USB
    default y

if SHIELD_CORNEDEON54_DONGLE
config ZMK_SPLIT_BLE_CENTRAL_PERIPHERALS
    default 2
endif

if SHIELD_CORNEDEON54_LEFT_CENTRAL
config ZMK_SPLIT_BLE_CENTRAL_PERIPHERALS
    default 1
endif

endif  # CENTRAL
```

## boards/shields/cornedeon54/Kconfig.shield
```kconfig
config SHIELD_CORNEDEON54_DONGLE
    def_bool $(shields_list_contains,cornedeon54_dongle)

config SHIELD_CORNEDEON54_LEFT
    def_bool $(shields_list_contains,cornedeon54_left)

config SHIELD_CORNEDEON54_LEFT_CENTRAL
    def_bool $(shields_list_contains,cornedeon54_left_central)

config SHIELD_CORNEDEON54_RIGHT
    def_bool $(shields_list_contains,cornedeon54_right)
```
